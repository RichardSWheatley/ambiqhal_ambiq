## CMakeLists.txt
```
# SPDX-License-Identifier: Apache-2.0
cmake_minimum_required(VERSION 3.20.0)
find_package(Zephyr REQUIRED HINTS $ENV{ZEPHYR_BASE})
project(weaver_scenarios)

target_sources(app PRIVATE
	src/main.c
	src/scen_imu_overrun.c
	src/scen_ble_deadline.c
	src/scen_ppg_latency.c
	src/scen_burst_shed.c
	src/scen_display_defer.c
)
```

## sample.yaml
```
sample:
  description: Five isolated behavioral scenarios for the Weaver scheduler.
    Each isolates one Weaver feature so its contribution can be measured
    independently. Diff the default (Weaver) build against stock.conf to
    populate the RFC M1-M7 metrics. Synthetic FIFOs; no external hardware
    needed; builds for both apollo510_evb and apollo510b_evb.
  name: Weaver Scenarios
common:
  tags:
    - kernel
    - weaver
    - scenarios
  harness: console
  harness_config:
    type: one_line
    regex:
      - "SCENARIOS COMPLETE"
tests:
  sample.kernel.weaver_scenarios.weaver:
    platform_allow:
      - apollo510_evb
      - apollo510b_evb
    integration_platforms:
      - apollo510_evb
      - apollo510b_evb
  sample.kernel.weaver_scenarios.stock:
    platform_allow:
      - apollo510_evb
      - apollo510b_evb
    integration_platforms:
      - apollo510_evb
      - apollo510b_evb
    extra_args: EXTRA_CONF_FILE=stock.conf
```

## prj.conf
```kconfig
# Default: Weaver scalar variant. Override to stock with stock.conf,
# or to other variants with hybrid.conf / mve.conf / fp.conf as in
# the benchmark sample.

CONFIG_WEAVER_SCHED=y
CONFIG_WEAVER_WEARABLE_PRESET=y
CONFIG_WEAVER_BATCH_SCALAR=y
CONFIG_WEAVER_TIMING=y

CONFIG_LOG=y
CONFIG_LOG_MODE_MINIMAL=y
CONFIG_THREAD_NAME=y
CONFIG_THREAD_RUNTIME_STATS=y

CONFIG_MAIN_STACK_SIZE=4096
CONFIG_HEAP_MEM_POOL_SIZE=4096
CONFIG_SYS_CLOCK_TICKS_PER_SEC=1000
CONFIG_MP_MAX_NUM_CPUS=1
```

## stock.conf
```kconfig
# Stock Zephyr baseline: Weaver compiled out entirely. Same workload,
# same priorities, no scheduler-layer intervention. Diff against the
# default build to measure Weaver's contribution per scenario.
CONFIG_WEAVER_SCHED=n
```

## src/main.c
```c
/*
 * Copyright (c) 2026 Ambiq Micro, Inc.
 * SPDX-License-Identifier: Apache-2.0
 *
 * Weaver isolation scenarios driver.
 *
 * Runs 5 focused scenarios sequentially. Each isolates one specific
 * Weaver feature so its contribution can be attributed cleanly.
 * Build twice (stock.conf and default) and diff the SCEN-CSV lines
 * to populate the RFC M1-M7 acceptance table.
 */

#include <zephyr/kernel.h>
#include <zephyr/sys/printk.h>
#include "scen_common.h"

int main(void)
{
	printk("\n=== Weaver Scenarios [%s] on Apollo510B EVB LP @ 96 MHz ===\n",
	       BUILD_LABEL);
	printk("5 isolation scenarios, ~75 s total\n\n");

	struct scen_result results[5] = {0};

	printk("[scen 1/5] imu_overrun       (20 s) ...\n");
	scen_imu_overrun(&results[0]);
	printk("[scen 2/5] ble_deadline      (15 s) ...\n");
	scen_ble_deadline(&results[1]);
	printk("[scen 3/5] ppg_latency       (12 s) ...\n");
	scen_ppg_latency(&results[2]);
	printk("[scen 4/5] burst_shed        (12 s) ...\n");
	scen_burst_shed(&results[3]);
	printk("[scen 5/5] display_defer     (15 s) ...\n");
	scen_display_defer(&results[4]);

	printk("\n--- SCENARIO RESULTS [%s] ---\n", BUILD_LABEL);
	for (int i = 0; i < 5; i++) {
		struct scen_result *r = &results[i];
		printk("S%d %-15s pass=%d overruns=%-6u misses=%-4u "
		       "p50=%-6u p99=%-6u max=%-6u throttle_peak=%-3u "
		       "%s=%u\n",
		       i + 1, r->name, r->pass,
		       r->overruns, r->deadline_misses,
		       r->latency_p50_us, r->latency_p99_us, r->latency_max_us,
		       r->throttle_peak,
		       r->misc_label ? r->misc_label : "n/a", r->misc);
	}

	/* Machine-readable single line per scenario for diff scripts. */
	printk("\n");
	for (int i = 0; i < 5; i++) {
		struct scen_result *r = &results[i];
		printk("SCEN-CSV %s,%s,%d,%u,%u,%u,%u,%u,%u,%u\n",
		       BUILD_LABEL, r->name, r->pass,
		       r->overruns, r->deadline_misses,
		       r->latency_p50_us, r->latency_p99_us, r->latency_max_us,
		       r->throttle_peak, r->misc);
	}

	printk("\nSCENARIOS COMPLETE\n");
	return 0;
}
```

## src/scen_ble_deadline.c
```c
/*
 * Copyright (c) 2026 Ambiq Micro, Inc.
 * SPDX-License-Identifier: Apache-2.0
 *
 * Scenario 2: BLE LL deadline integrity under heavy Weft contention.
 *
 * Models a 50 ms BLE connection event (3 ms work window) competing
 * with several Weft threads that each do bursty CPU work. The BLE
 * thread is Warp under Weaver; its deadline is registered.
 *
 * Each BLE wakeup records the timestamp delta vs. its expected 50 ms
 * cadence. A miss is defined as >1 ms late.
 *
 * Stock Zephyr: BLE wins on static priority alone. The Weft threads
 *               can still steal cycles right up to the BLE wake
 *               instant via timeslicing, occasionally pushing the
 *               BLE start past its window.
 *
 * Weaver:       Pre-Warp guard window suppresses Weft promotion when
 *               BLE deadline is within CONFIG_WEAVER_PREWARP_GUARD_TICKS
 *               ticks; BLE sees a quiet system.
 *
 * PASS threshold (M3 hard gate): Weaver miss count <= stock miss count.
 * No regression is acceptable. Improvement is bonus.
 */

#include "scen_common.h"
#include <zephyr/sys/printk.h>

#define DUR_MS          15000
#define BLE_PERIOD_MS   50
#define BLE_WORK_US     3000
#define MISS_THRESH_US  1000   /* >1 ms late counts as miss */
#define N_NOISE         3
#define NOISE_PERIOD_MS 8
#define NOISE_WORK_US   5000

#define BLE_PRIO    2
#define NOISE_PRIO  6

static atomic_t s2_misses;
static atomic_t s2_wakes;
static atomic_t s2_stop;

static K_THREAD_STACK_DEFINE(s2_ble_stack, SCEN_STACK_SIZE);
static K_THREAD_STACK_ARRAY_DEFINE(s2_noise_stacks, N_NOISE, SCEN_STACK_SIZE);
static struct k_thread s2_ble_t;
static struct k_thread s2_noise_t[N_NOISE];

#ifdef CONFIG_WEAVER_SCHED
static struct weaver_thread_data s2_ble_wd, s2_noise_wd[N_NOISE];
static void s2_tick(struct k_timer *t) { ARG_UNUSED(t); weaver_tick(); }
static K_TIMER_DEFINE(s2_timer, s2_tick, NULL);
#endif

static void s2_ble(void *a, void *b, void *c)
{
	ARG_UNUSED(a); ARG_UNUSED(b); ARG_UNUSED(c);
	uint32_t expected = k_uptime_get_32();
	while (!atomic_get(&s2_stop)) {
		expected += BLE_PERIOD_MS;
		k_sleep(K_TIMEOUT_ABS_MS(expected));

		uint32_t now = k_uptime_get_32();
		int32_t late_ms = (int32_t)(now - expected);
		if (late_ms * 1000 > (int32_t)MISS_THRESH_US) {
			atomic_inc(&s2_misses);
		}
		atomic_inc(&s2_wakes);
		k_busy_wait(BLE_WORK_US);
	}
}

static void s2_noise(void *a, void *b, void *c)
{
	ARG_UNUSED(a); ARG_UNUSED(b); ARG_UNUSED(c);
	while (!atomic_get(&s2_stop)) {
		k_busy_wait(NOISE_WORK_US);
		k_sleep(K_MSEC(NOISE_PERIOD_MS));
	}
}

void scen_ble_deadline(struct scen_result *out)
{
	atomic_set(&s2_misses, 0);
	atomic_set(&s2_wakes, 0);
	atomic_set(&s2_stop, 0);

	k_thread_create(&s2_ble_t, s2_ble_stack, SCEN_STACK_SIZE,
			s2_ble, NULL, NULL, NULL, BLE_PRIO, 0, K_NO_WAIT);
#ifdef CONFIG_WEAVER_SCHED
	weaver_register(&s2_ble_wd, &s2_ble_t, WEAVER_TO_Q16(20), true);
	weaver_set_warp_deadline(&s2_ble_wd, BLE_PERIOD_MS);
#endif

	for (int i = 0; i < N_NOISE; i++) {
		k_thread_create(&s2_noise_t[i], s2_noise_stacks[i], SCEN_STACK_SIZE,
				s2_noise, NULL, NULL, NULL, NOISE_PRIO, 0, K_NO_WAIT);
#ifdef CONFIG_WEAVER_SCHED
		weaver_register(&s2_noise_wd[i], &s2_noise_t[i],
				WEAVER_TO_Q16(5), false);
#endif
	}

#ifdef CONFIG_WEAVER_SCHED
	k_timer_start(&s2_timer, K_MSEC(1), K_MSEC(1));
#endif

	k_sleep(K_MSEC(DUR_MS));
	atomic_set(&s2_stop, 1);
	k_sleep(K_MSEC(50));

#ifdef CONFIG_WEAVER_SCHED
	k_timer_stop(&s2_timer);
	weaver_unregister(&s2_ble_wd);
	for (int i = 0; i < N_NOISE; i++) weaver_unregister(&s2_noise_wd[i]);
#endif

	k_thread_abort(&s2_ble_t);
	for (int i = 0; i < N_NOISE; i++) k_thread_abort(&s2_noise_t[i]);

	out->name = "ble_deadline";
	out->deadline_misses = atomic_get(&s2_misses);
	out->misc_label = "ble_wakes";
	out->misc       = atomic_get(&s2_wakes);
	out->pass = (atomic_get(&s2_misses) == 0);  /* hard gate */
}
```

## src/scen_burst_shed.c
```c
/*
 * Copyright (c) 2026 Ambiq Micro, Inc.
 * SPDX-License-Identifier: Apache-2.0
 *
 * Scenario 4: Burst-event throttle shedding via fuzzy controller.
 *
 * Four Weft "producer" threads run at steady state. At t=3s, t=6s,
 * t=9s, a burst event fires that ramps each producer's buffer_fill
 * synthetically up to 1.0 over 200 ms (simulating a cascade of
 * sensor events). We then observe the fuzzy throttle level and
 * verify it ramps up smoothly without flapping.
 *
 * Stock Zephyr: no concept of "system pressure", no graded throttle
 *               signal exists at all.
 *
 * Weaver:       weaver_throttle_level() rises smoothly during the
 *               burst, plateaus at >= 200, then decays cleanly.
 *               weaver_should_throttle() goes true ONCE per burst,
 *               not many times (EMA hysteresis suppresses flap).
 *
 * Metric:       peak observed weaver_throttle_level() during bursts
 *               and number of distinct throttle "entry" events.
 *
 * PASS:         stock can't report a throttle level - the comparison
 *               is qualitative. Weaver should reach >= 192 during a
 *               burst and recover to 0 between bursts.
 */

#include "scen_common.h"
#include <zephyr/sys/printk.h>

#define DUR_MS      12000
#define N_WEFTS     4
#define BURST_DUR_MS 200

static atomic_t s4_stop;
static uint32_t s4_peak_throttle;

static K_THREAD_STACK_ARRAY_DEFINE(s4_stacks, N_WEFTS, SCEN_STACK_SIZE);
static struct k_thread s4_t[N_WEFTS];

#ifdef CONFIG_WEAVER_SCHED
static struct weaver_thread_data s4_wd[N_WEFTS];
static void s4_tick(struct k_timer *t) { ARG_UNUSED(t); weaver_tick(); }
static K_TIMER_DEFINE(s4_timer, s4_tick, NULL);
#endif

static atomic_t s4_burst_active;
static atomic_t s4_burst_ramp_pct;  /* 0-100 */

static void s4_weft(void *arg, void *b, void *c)
{
	ARG_UNUSED(b); ARG_UNUSED(c);
	uintptr_t id = (uintptr_t)arg;
	while (!atomic_get(&s4_stop)) {
		(void)id;
#ifdef CONFIG_WEAVER_SCHED
		uint32_t pct = atomic_get(&s4_burst_ramp_pct);
		uint32_t fill_q16 = (pct * WEAVER_Q16_ONE) / 100U;
		weaver_set_buffer_fill_predictive_q16(&s4_wd[id], fill_q16);
#endif
		k_sleep(K_MSEC(5));
	}
}

void scen_burst_shed(struct scen_result *out)
{
	atomic_set(&s4_stop, 0);
	atomic_set(&s4_burst_active, 0);
	atomic_set(&s4_burst_ramp_pct, 0);
	s4_peak_throttle = 0;
	uint32_t throttle_entries = 0;
	bool was_throttling = false;

	for (int i = 0; i < N_WEFTS; i++) {
		k_thread_create(&s4_t[i], s4_stacks[i], SCEN_STACK_SIZE,
				s4_weft, (void *)(uintptr_t)i, NULL, NULL,
				7, 0, K_NO_WAIT);
#ifdef CONFIG_WEAVER_SCHED
		weaver_register(&s4_wd[i], &s4_t[i], WEAVER_TO_Q16(7), false);
#endif
	}
#ifdef CONFIG_WEAVER_SCHED
	k_timer_start(&s4_timer, K_MSEC(1), K_MSEC(1));
#endif

	const uint32_t burst_times_ms[] = { 3000, 6000, 9000 };
	uint32_t t0 = k_uptime_get_32();

	while (1) {
		uint32_t now = k_uptime_get_32() - t0;
		if (now >= DUR_MS) break;

		/* Drive burst ramps. */
		uint32_t ramp = 0;
		for (size_t i = 0; i < ARRAY_SIZE(burst_times_ms); i++) {
			uint32_t bs = burst_times_ms[i];
			if (now >= bs && now < bs + BURST_DUR_MS) {
				ramp = ((now - bs) * 100U) / BURST_DUR_MS;
			} else if (now >= bs + BURST_DUR_MS &&
				   now < bs + 2 * BURST_DUR_MS) {
				/* Decay back to 0 over BURST_DUR_MS. */
				ramp = 100U - (((now - bs - BURST_DUR_MS) * 100U) /
					       BURST_DUR_MS);
			}
		}
		atomic_set(&s4_burst_ramp_pct, ramp);

#ifdef CONFIG_WEAVER_SCHED
		uint8_t lvl = weaver_throttle_level();
		if (lvl > s4_peak_throttle) s4_peak_throttle = lvl;
		bool throttling = weaver_should_throttle();
		if (throttling && !was_throttling) throttle_entries++;
		was_throttling = throttling;
#endif
		k_sleep(K_MSEC(10));
	}

	atomic_set(&s4_stop, 1);
	k_sleep(K_MSEC(50));

#ifdef CONFIG_WEAVER_SCHED
	k_timer_stop(&s4_timer);
	for (int i = 0; i < N_WEFTS; i++) weaver_unregister(&s4_wd[i]);
#endif
	for (int i = 0; i < N_WEFTS; i++) k_thread_abort(&s4_t[i]);

	out->name = "burst_shed";
	out->throttle_peak = s4_peak_throttle;
	out->misc_label = "throttle_entries";
	out->misc = throttle_entries;
#ifdef CONFIG_WEAVER_SCHED
	out->pass = (s4_peak_throttle >= 192) &&
		    (throttle_entries == ARRAY_SIZE(burst_times_ms));
#else
	out->pass = false;  /* stock can't satisfy this scenario at all */
#endif
}
```

## src/scen_common.h
```c
/*
 * Copyright (c) 2026 Ambiq Micro, Inc.
 * SPDX-License-Identifier: Apache-2.0
 *
 * Shared scaffolding for the five Weaver isolation scenarios.
 *
 * Each scenario constructs its own thread set, runs for a fixed
 * window, then reports a single-line result. main.c runs them
 * sequentially so one flash + one log capture exercises all five.
 *
 * Each scenario is intentionally MINIMAL - it isolates one Weaver
 * feature (pressure boost, pre-Warp guard, predictive fill, fuzzy
 * throttle, aging) so the metric improvement can be attributed to
 * the right design choice. Compare against samples/.../weaver_benchmark
 * for the integrated wearable workload.
 */

#ifndef WEAVER_SCEN_COMMON_H
#define WEAVER_SCEN_COMMON_H

#include <zephyr/kernel.h>
#include <zephyr/sys/atomic.h>

#ifdef CONFIG_WEAVER_SCHED
#include <zephyr/kernel/weaver_sched.h>
#endif

#define SCEN_STACK_SIZE   1536

/* Per-scenario result captured by the scenario function and printed
 * by main(). Each scenario fills only the fields it uses; the rest
 * stay zero.
 */
struct scen_result {
	const char *name;
	bool        pass;             /* PASS / FAIL relative to threshold */
	uint32_t    overruns;         /* count of dropped samples */
	uint32_t    latency_p50_us;
	uint32_t    latency_p99_us;
	uint32_t    latency_max_us;
	uint32_t    deadline_misses;
	uint32_t    throttle_peak;    /* peak fuzzy throttle level (0-255) */
	uint32_t    promotions;
	uint32_t    misc;             /* scenario-specific counter */
	const char *misc_label;
};

#if defined(CONFIG_WEAVER_SCHED)
#  define BUILD_LABEL "weaver"
#else
#  define BUILD_LABEL "stock"
#endif

/* Minimal P50/P99/max accumulator: 16 bucket histogram. */
#define HIST_BUCKETS 16
struct lat_hist {
	const uint32_t bucket_us[HIST_BUCKETS];
	atomic_t       buckets[HIST_BUCKETS];
	uint32_t       count;
	uint32_t       max_us;
};

static inline void lat_add(struct lat_hist *h, uint32_t us)
{
	for (int i = 0; i < HIST_BUCKETS; i++) {
		if (us <= h->bucket_us[i]) {
			atomic_inc(&h->buckets[i]);
			break;
		}
	}
	h->count++;
	if (us > h->max_us) h->max_us = us;
}

static inline uint32_t lat_percentile(const struct lat_hist *h, int pct)
{
	uint32_t total = 0;
	for (int i = 0; i < HIST_BUCKETS; i++) total += atomic_get(&h->buckets[i]);
	if (total == 0) return 0;
	uint32_t target = (total * pct) / 100;
	uint32_t cum = 0;
	for (int i = 0; i < HIST_BUCKETS; i++) {
		cum += atomic_get(&h->buckets[i]);
		if (cum >= target) return h->bucket_us[i];
	}
	return h->bucket_us[HIST_BUCKETS - 1];
}

/* Default latency bucket edges (microseconds). */
#define LAT_BUCKETS_DEFAULT { 50, 100, 200, 500, 1000, 2000, 5000, 10000, \
			      20000, 50000, 100000, 200000, 500000,      \
			      1000000, 2000000, UINT32_MAX }

/* Scenario entry points. main.c calls these in order. */
void scen_imu_overrun(struct scen_result *out);
void scen_ble_deadline(struct scen_result *out);
void scen_ppg_latency(struct scen_result *out);
void scen_burst_shed(struct scen_result *out);
void scen_display_defer(struct scen_result *out);

#endif /* WEAVER_SCEN_COMMON_H */
```

## src/scen_display_defer.c
```c
/*
 * Copyright (c) 2026 Ambiq Micro, Inc.
 * SPDX-License-Identifier: Apache-2.0
 *
 * Scenario 5: Display refresh + NVM flush deferral under sensor load.
 *
 * IMU at 100 Hz (10 ms period) with fusion consumer competes against:
 *   - Display refresh at 30 Hz, 4 ms work each
 *   - NVM flush every 250 ms, 12 ms work each
 *
 * Display and NVM are Weft, IMU + fusion are the priority path. NVM
 * is a long-running consumer that can preempt fusion under stock
 * Zephyr if their priorities allow it, causing IMU FIFO buildup.
 *
 * Metric: maximum IMU FIFO depth observed during the run. Lower is
 *         better.
 *
 * Stock Zephyr: display/NVM cycles get stolen at preempt points;
 *               peak IMU FIFO depth climbs during long NVM bursts.
 *
 * Weaver:       fusion's pressure rises as the FIFO fills, boosting
 *               it above display/NVM. Aging term ensures fusion
 *               eventually wins even when display work seems urgent.
 *
 * PASS:         Weaver peak_depth <= stock peak_depth (no regression
 *               on the IMU pipeline) and ideally <= 0.7 * stock.
 */

#include "scen_common.h"
#include <zephyr/sys/printk.h>

#define DUR_MS         15000
#define FIFO_DEPTH     64
#define IMU_PERIOD_MS  10      /* 100 Hz */
#define FUSION_DRAIN   4
#define FUSION_WORK_US 2000
#define DISP_PERIOD_MS 33      /* ~30 Hz */
#define DISP_WORK_US   4000
#define NVM_PERIOD_MS  250
#define NVM_WORK_US    12000

#define IMU_PRIO    4
#define FUSION_PRIO 8
#define DISP_PRIO   9
#define NVM_PRIO    10

static atomic_t s5_depth;
static atomic_t s5_peak;
static atomic_t s5_stop;

static K_THREAD_STACK_DEFINE(s5_imu_stack,    SCEN_STACK_SIZE);
static K_THREAD_STACK_DEFINE(s5_fusion_stack, SCEN_STACK_SIZE);
static K_THREAD_STACK_DEFINE(s5_disp_stack,   SCEN_STACK_SIZE);
static K_THREAD_STACK_DEFINE(s5_nvm_stack,    SCEN_STACK_SIZE);
static struct k_thread s5_imu_t, s5_fusion_t, s5_disp_t, s5_nvm_t;

#ifdef CONFIG_WEAVER_SCHED
static struct weaver_thread_data s5_imu_wd, s5_fusion_wd, s5_disp_wd, s5_nvm_wd;
static void s5_tick(struct k_timer *t) { ARG_UNUSED(t); weaver_tick(); }
static K_TIMER_DEFINE(s5_timer, s5_tick, NULL);

static inline uint32_t depth_to_q16(int d) {
	if (d <= 0) return 0;
	if (d >= FIFO_DEPTH) return WEAVER_Q16_ONE;
	return ((uint32_t)d * WEAVER_Q16_ONE) / FIFO_DEPTH;
}
#endif

static inline void track_peak(int d)
{
	uint32_t cur = atomic_get(&s5_peak);
	if ((uint32_t)d > cur) atomic_set(&s5_peak, d);
}

static void s5_imu(void *a, void *b, void *c)
{
	ARG_UNUSED(a); ARG_UNUSED(b); ARG_UNUSED(c);
	while (!atomic_get(&s5_stop)) {
		int d = atomic_inc(&s5_depth) + 1;
		if (d > FIFO_DEPTH) {
			atomic_set(&s5_depth, FIFO_DEPTH);
			d = FIFO_DEPTH;
		}
		track_peak(d);
#ifdef CONFIG_WEAVER_SCHED
		weaver_set_buffer_fill_predictive_q16(&s5_fusion_wd, depth_to_q16(d));
#endif
		k_sleep(K_MSEC(IMU_PERIOD_MS));
	}
}

static void s5_fusion(void *a, void *b, void *c)
{
	ARG_UNUSED(a); ARG_UNUSED(b); ARG_UNUSED(c);
	while (!atomic_get(&s5_stop)) {
		int d = atomic_get(&s5_depth);
		if (d > 0) {
			int drain = MIN(d, FUSION_DRAIN);
			atomic_sub(&s5_depth, drain);
			k_busy_wait(FUSION_WORK_US);
#ifdef CONFIG_WEAVER_SCHED
			weaver_set_buffer_fill_predictive_q16(
				&s5_fusion_wd, depth_to_q16(atomic_get(&s5_depth)));
#endif
		}
		k_sleep(K_MSEC(5));
	}
}

static void s5_disp(void *a, void *b, void *c)
{
	ARG_UNUSED(a); ARG_UNUSED(b); ARG_UNUSED(c);
	while (!atomic_get(&s5_stop)) {
		k_busy_wait(DISP_WORK_US);
		k_sleep(K_MSEC(DISP_PERIOD_MS));
	}
}

static void s5_nvm(void *a, void *b, void *c)
{
	ARG_UNUSED(a); ARG_UNUSED(b); ARG_UNUSED(c);
	while (!atomic_get(&s5_stop)) {
		k_busy_wait(NVM_WORK_US);
		k_sleep(K_MSEC(NVM_PERIOD_MS));
	}
}

void scen_display_defer(struct scen_result *out)
{
	atomic_set(&s5_depth, 0);
	atomic_set(&s5_peak, 0);
	atomic_set(&s5_stop, 0);

	k_thread_create(&s5_imu_t,    s5_imu_stack,    SCEN_STACK_SIZE,
			s5_imu,    NULL, NULL, NULL, IMU_PRIO,    0, K_NO_WAIT);
	k_thread_create(&s5_fusion_t, s5_fusion_stack, SCEN_STACK_SIZE,
			s5_fusion, NULL, NULL, NULL, FUSION_PRIO, 0, K_NO_WAIT);
	k_thread_create(&s5_disp_t,   s5_disp_stack,   SCEN_STACK_SIZE,
			s5_disp,   NULL, NULL, NULL, DISP_PRIO,   0, K_NO_WAIT);
	k_thread_create(&s5_nvm_t,    s5_nvm_stack,    SCEN_STACK_SIZE,
			s5_nvm,    NULL, NULL, NULL, NVM_PRIO,    0, K_NO_WAIT);

#ifdef CONFIG_WEAVER_SCHED
	weaver_register(&s5_imu_wd,    &s5_imu_t,    WEAVER_TO_Q16(15), true);
	weaver_set_warp_deadline(&s5_imu_wd, IMU_PERIOD_MS);
	weaver_register(&s5_fusion_wd, &s5_fusion_t, WEAVER_TO_Q16(8),  false);
	weaver_register(&s5_disp_wd,   &s5_disp_t,   WEAVER_TO_Q16(4),  false);
	weaver_register(&s5_nvm_wd,    &s5_nvm_t,    WEAVER_TO_Q16(2),  false);
	k_timer_start(&s5_timer, K_MSEC(1), K_MSEC(1));
#endif

	k_sleep(K_MSEC(DUR_MS));
	atomic_set(&s5_stop, 1);
	k_sleep(K_MSEC(50));

#ifdef CONFIG_WEAVER_SCHED
	k_timer_stop(&s5_timer);
	weaver_unregister(&s5_imu_wd);
	weaver_unregister(&s5_fusion_wd);
	weaver_unregister(&s5_disp_wd);
	weaver_unregister(&s5_nvm_wd);
#endif
	k_thread_abort(&s5_imu_t);
	k_thread_abort(&s5_fusion_t);
	k_thread_abort(&s5_disp_t);
	k_thread_abort(&s5_nvm_t);

	out->name = "display_defer";
	out->misc_label = "peak_fifo_depth";
	out->misc       = atomic_get(&s5_peak);
	out->pass = true;
}
```

## src/scen_imu_overrun.c
```c
/*
 * Copyright (c) 2026 Ambiq Micro, Inc.
 * SPDX-License-Identifier: Apache-2.0
 *
 * Scenario 1: IMU FIFO overrun under sustained 200 Hz production.
 *
 * IMU producer runs at 200 Hz (1 sample per 5 ms). Fusion consumer
 * normally drains 8 samples per pass but the work takes 1.5 ms so
 * the ring fills if fusion doesn't get enough CPU. A "noise" Weft
 * thread does aggressive 3 ms of work every 4 ms - just barely
 * dominant enough at equal priority to starve fusion under stock
 * Zephyr.
 *
 * Stock Zephyr:  fusion + noise are both at preemptible priority 8.
 *                Round-robin gives them equal time. Fusion can't
 *                keep up with 200 Hz, FIFO overruns.
 *
 * Weaver:        fusion's buffer_fill_q16 rises as the ring fills,
 *                which boosts fusion above noise via Weft promotion.
 *                FIFO stays bounded.
 *
 * PASS threshold (M1): Weaver overruns <= 0.5 * stock overruns.
 */

#include "scen_common.h"
#include <zephyr/sys/printk.h>

#define DUR_MS          20000   /* 20 s run */
#define FIFO_DEPTH      32
#define IMU_PERIOD_MS   5       /* 200 Hz */
#define FUSION_DRAIN    8       /* samples per fusion pass */
#define FUSION_WORK_US  1500
#define NOISE_PERIOD_MS 4
#define NOISE_WORK_US   3000

#define IMU_PRIO    3
#define FUSION_PRIO 8
#define NOISE_PRIO  8

static atomic_t s1_ring;
static atomic_t s1_overruns;
static atomic_t s1_stop;

static K_THREAD_STACK_DEFINE(s1_imu_stack,    SCEN_STACK_SIZE);
static K_THREAD_STACK_DEFINE(s1_fusion_stack, SCEN_STACK_SIZE);
static K_THREAD_STACK_DEFINE(s1_noise_stack,  SCEN_STACK_SIZE);
static struct k_thread s1_imu_t, s1_fusion_t, s1_noise_t;

#ifdef CONFIG_WEAVER_SCHED
static struct weaver_thread_data s1_imu_wd, s1_fusion_wd, s1_noise_wd;

static void s1_tick(struct k_timer *t) { ARG_UNUSED(t); weaver_tick(); }
static K_TIMER_DEFINE(s1_timer, s1_tick, NULL);

static inline uint32_t depth_to_q16(int d) {
	if (d <= 0) return 0;
	if (d >= FIFO_DEPTH) return WEAVER_Q16_ONE;
	return ((uint32_t)d * WEAVER_Q16_ONE) / FIFO_DEPTH;
}
#endif

static void s1_imu(void *a, void *b, void *c)
{
	ARG_UNUSED(a); ARG_UNUSED(b); ARG_UNUSED(c);
	while (!atomic_get(&s1_stop)) {
		int d = atomic_inc(&s1_ring) + 1;
		if (d > FIFO_DEPTH) {
			atomic_set(&s1_ring, FIFO_DEPTH);
			atomic_inc(&s1_overruns);
		}
#ifdef CONFIG_WEAVER_SCHED
		weaver_set_buffer_fill_predictive_q16(&s1_fusion_wd, depth_to_q16(d));
#endif
		k_sleep(K_MSEC(IMU_PERIOD_MS));
	}
}

static void s1_fusion(void *a, void *b, void *c)
{
	ARG_UNUSED(a); ARG_UNUSED(b); ARG_UNUSED(c);
	while (!atomic_get(&s1_stop)) {
		int d = atomic_get(&s1_ring);
		if (d > 0) {
			int drain = MIN(d, FUSION_DRAIN);
			atomic_sub(&s1_ring, drain);
			k_busy_wait(FUSION_WORK_US);
#ifdef CONFIG_WEAVER_SCHED
			weaver_set_buffer_fill_predictive_q16(
				&s1_fusion_wd,
				depth_to_q16(atomic_get(&s1_ring)));
#endif
		}
		k_sleep(K_MSEC(2));
	}
}

static void s1_noise(void *a, void *b, void *c)
{
	ARG_UNUSED(a); ARG_UNUSED(b); ARG_UNUSED(c);
	while (!atomic_get(&s1_stop)) {
		k_busy_wait(NOISE_WORK_US);
		k_sleep(K_MSEC(NOISE_PERIOD_MS));
	}
}

void scen_imu_overrun(struct scen_result *out)
{
	atomic_set(&s1_ring, 0);
	atomic_set(&s1_overruns, 0);
	atomic_set(&s1_stop, 0);

	k_thread_create(&s1_imu_t,    s1_imu_stack,    SCEN_STACK_SIZE,
			s1_imu,    NULL, NULL, NULL, IMU_PRIO,    0, K_NO_WAIT);
	k_thread_create(&s1_fusion_t, s1_fusion_stack, SCEN_STACK_SIZE,
			s1_fusion, NULL, NULL, NULL, FUSION_PRIO, 0, K_NO_WAIT);
	k_thread_create(&s1_noise_t,  s1_noise_stack,  SCEN_STACK_SIZE,
			s1_noise,  NULL, NULL, NULL, NOISE_PRIO,  0, K_NO_WAIT);

#ifdef CONFIG_WEAVER_SCHED
	weaver_register(&s1_imu_wd,    &s1_imu_t,    WEAVER_TO_Q16(15), true);
	weaver_set_warp_deadline(&s1_imu_wd, IMU_PERIOD_MS);
	weaver_register(&s1_fusion_wd, &s1_fusion_t, WEAVER_TO_Q16(8),  false);
	weaver_register(&s1_noise_wd,  &s1_noise_t,  WEAVER_TO_Q16(5),  false);
	k_timer_start(&s1_timer, K_MSEC(1), K_MSEC(1));
#endif

	k_sleep(K_MSEC(DUR_MS));
	atomic_set(&s1_stop, 1);
	k_sleep(K_MSEC(50));

#ifdef CONFIG_WEAVER_SCHED
	k_timer_stop(&s1_timer);
	weaver_unregister(&s1_imu_wd);
	weaver_unregister(&s1_fusion_wd);
	weaver_unregister(&s1_noise_wd);
#endif

	k_thread_abort(&s1_imu_t);
	k_thread_abort(&s1_fusion_t);
	k_thread_abort(&s1_noise_t);

	out->name     = "imu_overrun";
	out->overruns = atomic_get(&s1_overruns);
	out->misc_label = "duration_ms";
	out->misc       = DUR_MS;
	/* PASS is judged by the harness after capturing both stock and
	 * weaver runs; we just emit the number. */
	out->pass = true;
}
```

## src/scen_ppg_latency.c
```c
/*
 * Copyright (c) 2026 Ambiq Micro, Inc.
 * SPDX-License-Identifier: Apache-2.0
 *
 * Scenario 3: PPG -> HR sensor-to-process latency tail.
 *
 * PPG producer pushes a sample every 10 ms (100 Hz, 4x nominal).
 * HR consumer wakes when samples are available, does 8 ms FFT work
 * per batch of 4 samples. A "noise" thread does 6 ms of CPU work
 * every 10 ms - just enough to delay HR if scheduled equally.
 *
 * For each PPG sample we record the timestamp delta between
 * production and the start of the HR processing pass that consumed
 * it. The P99 of these deltas is the metric.
 *
 * Stock Zephyr: HR + noise at the same priority round-robin. HR's
 *               long 8 ms work period creates head-of-line blocking;
 *               P99 latency tails into the tens of ms.
 *
 * Weaver:       Predictive buffer-fill helper (fill + (fill - last_fill))
 *               anticipates the queue filling and boosts HR one tick
 *               BEFORE the overflow. P99 stays bounded.
 *
 * PASS threshold (M2): Weaver P99 latency <= 0.7 * stock P99.
 */

#include "scen_common.h"
#include <zephyr/sys/printk.h>

#define DUR_MS         12000
#define FIFO_DEPTH     16
#define PPG_PERIOD_MS  10
#define HR_BATCH       4
#define HR_WORK_US     8000
#define NOISE_PERIOD_MS 10
#define NOISE_WORK_US  6000

#define PPG_PRIO    4
#define HR_PRIO     8
#define NOISE_PRIO  8

static atomic_t s3_depth;
static atomic_t s3_stop;
static uint32_t s3_ts_ring[FIFO_DEPTH];
static atomic_t s3_head, s3_tail;
static struct lat_hist s3_lat = { .bucket_us = LAT_BUCKETS_DEFAULT };

static K_THREAD_STACK_DEFINE(s3_ppg_stack,   SCEN_STACK_SIZE);
static K_THREAD_STACK_DEFINE(s3_hr_stack,    SCEN_STACK_SIZE);
static K_THREAD_STACK_DEFINE(s3_noise_stack, SCEN_STACK_SIZE);
static struct k_thread s3_ppg_t, s3_hr_t, s3_noise_t;

#ifdef CONFIG_WEAVER_SCHED
static struct weaver_thread_data s3_ppg_wd, s3_hr_wd, s3_noise_wd;
static void s3_tick(struct k_timer *t) { ARG_UNUSED(t); weaver_tick(); }
static K_TIMER_DEFINE(s3_timer, s3_tick, NULL);

static inline uint32_t depth_to_q16(int d) {
	if (d <= 0) return 0;
	if (d >= FIFO_DEPTH) return WEAVER_Q16_ONE;
	return ((uint32_t)d * WEAVER_Q16_ONE) / FIFO_DEPTH;
}
#endif

static void s3_ppg(void *a, void *b, void *c)
{
	ARG_UNUSED(a); ARG_UNUSED(b); ARG_UNUSED(c);
	while (!atomic_get(&s3_stop)) {
		int h = atomic_inc(&s3_head);
		s3_ts_ring[h % FIFO_DEPTH] = k_cyc_to_us_floor32(k_cycle_get_32());
		int d = atomic_inc(&s3_depth) + 1;
		if (d > FIFO_DEPTH) atomic_set(&s3_depth, FIFO_DEPTH);
#ifdef CONFIG_WEAVER_SCHED
		weaver_set_buffer_fill_predictive_q16(&s3_hr_wd, depth_to_q16(d));
#endif
		k_sleep(K_MSEC(PPG_PERIOD_MS));
	}
}

static void s3_hr(void *a, void *b, void *c)
{
	ARG_UNUSED(a); ARG_UNUSED(b); ARG_UNUSED(c);
	while (!atomic_get(&s3_stop)) {
		int d = atomic_get(&s3_depth);
		if (d >= HR_BATCH) {
			uint32_t now = k_cyc_to_us_floor32(k_cycle_get_32());
			for (int i = 0; i < HR_BATCH; i++) {
				int t = atomic_inc(&s3_tail);
				uint32_t prod_us = s3_ts_ring[t % FIFO_DEPTH];
				lat_add(&s3_lat, now - prod_us);
			}
			atomic_sub(&s3_depth, HR_BATCH);
			k_busy_wait(HR_WORK_US);
#ifdef CONFIG_WEAVER_SCHED
			weaver_set_buffer_fill_predictive_q16(
				&s3_hr_wd, depth_to_q16(atomic_get(&s3_depth)));
#endif
		}
		k_sleep(K_MSEC(2));
	}
}

static void s3_noise(void *a, void *b, void *c)
{
	ARG_UNUSED(a); ARG_UNUSED(b); ARG_UNUSED(c);
	while (!atomic_get(&s3_stop)) {
		k_busy_wait(NOISE_WORK_US);
		k_sleep(K_MSEC(NOISE_PERIOD_MS));
	}
}

void scen_ppg_latency(struct scen_result *out)
{
	atomic_set(&s3_depth, 0);
	atomic_set(&s3_head, 0);
	atomic_set(&s3_tail, 0);
	atomic_set(&s3_stop, 0);
	for (int i = 0; i < HIST_BUCKETS; i++) atomic_set(&s3_lat.buckets[i], 0);
	s3_lat.count = 0; s3_lat.max_us = 0;

	k_thread_create(&s3_ppg_t,   s3_ppg_stack,   SCEN_STACK_SIZE,
			s3_ppg,   NULL, NULL, NULL, PPG_PRIO,   0, K_NO_WAIT);
	k_thread_create(&s3_hr_t,    s3_hr_stack,    SCEN_STACK_SIZE,
			s3_hr,    NULL, NULL, NULL, HR_PRIO,    0, K_NO_WAIT);
	k_thread_create(&s3_noise_t, s3_noise_stack, SCEN_STACK_SIZE,
			s3_noise, NULL, NULL, NULL, NOISE_PRIO, 0, K_NO_WAIT);

#ifdef CONFIG_WEAVER_SCHED
	weaver_register(&s3_ppg_wd,   &s3_ppg_t,   WEAVER_TO_Q16(15), true);
	weaver_set_warp_deadline(&s3_ppg_wd, PPG_PERIOD_MS);
	weaver_register(&s3_hr_wd,    &s3_hr_t,    WEAVER_TO_Q16(8),  false);
	weaver_register(&s3_noise_wd, &s3_noise_t, WEAVER_TO_Q16(5),  false);
	k_timer_start(&s3_timer, K_MSEC(1), K_MSEC(1));
#endif

	k_sleep(K_MSEC(DUR_MS));
	atomic_set(&s3_stop, 1);
	k_sleep(K_MSEC(50));

#ifdef CONFIG_WEAVER_SCHED
	k_timer_stop(&s3_timer);
	weaver_unregister(&s3_ppg_wd);
	weaver_unregister(&s3_hr_wd);
	weaver_unregister(&s3_noise_wd);
#endif

	k_thread_abort(&s3_ppg_t);
	k_thread_abort(&s3_hr_t);
	k_thread_abort(&s3_noise_t);

	out->name = "ppg_latency";
	out->latency_p50_us = lat_percentile(&s3_lat, 50);
	out->latency_p99_us = lat_percentile(&s3_lat, 99);
	out->latency_max_us = s3_lat.max_us;
	out->misc_label = "samples";
	out->misc       = s3_lat.count;
	out->pass = true;
}
```
