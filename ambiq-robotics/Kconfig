## ambiq-robotics/Kconfig
```kconfig
# Ambiq Robotics Broker (ARB) - Zephyr module
#
# SPDX-License-Identifier: Apache-2.0
# Copyright (c) 2026 Ambiq Micro Inc. <www.ambiq.com>

menuconfig ARB
	bool "Ambiq Robotics Broker (ARB)"
	select ZBUS
	help
	  Robotics building blocks on top of zbus: a shared message vocabulary
	  (arb/msg.h), well-known channels (arb/topics.h), JAUS/ROS2-style node
	  lifecycle with emergency stop (arb/node.h), and control helpers
	  (PID, differential-drive kinematics). Messaging is plain zbus.

if ARB

module = ARB
module-str = arb
source "subsys/logging/Kconfig.template.log_config"

config ARB_MAX_NODES
	int "Maximum number of lifecycle nodes"
	default 8

config ARB_HEARTBEAT_TICK_MS
	int "Heartbeat scheduler resolution (ms)"
	default 100
	help
	  Node heartbeats are published from a delayable work item that runs at
	  this period; individual node periods round up to it.

choice ARB_TIME_SOURCE
	prompt "Time base for message stamps"
	default ARB_TIME_UPTIME
	help
	  Source behind arb_time_now_us(), used for every message stamp.

config ARB_TIME_UPTIME
	bool "Local kernel uptime"
	help
	  Monotonic local time; meaningless across the link.

config ARB_TIME_PTP
	bool "PTP clock device"
	depends on PTP_CLOCK
	help
	  Read the ptp_clock device named by the devicetree chosen node
	  "arb,ptp-clock" - the backend for boards disciplined by gPTP.
	  Falls back to local uptime while the device is not ready.

endchoice

config ARB_TRANSPORT
	bool "Serial transport (bridge channels over a UART)"
	depends on SERIAL
	depends on UART_INTERRUPT_DRIVEN
	select ZBUS_RUNTIME_OBSERVERS
	help
	  Frame exported zbus channels over the UART named by the devicetree
	  chosen node "arb,uart" and publish received frames onto the matching
	  channels. Wire format: 0x7E | topic(2) | len(2) | payload | crc16.

endif # ARB
```

## ambiq-robotics/benchmarks/e2e_cmd_vel/testcase.yaml
```yaml
common:
  tags:
    - arb
    - benchmark
  harness: console
  timeout: 300
  harness_config:
    type: one_line
    regex:
      - "BENCH DONE"
    record:
      regex:
        - "RECORD:(?P<metrics>.*)"
      as_json: ["metrics"]
tests:
  arb.bench.e2e_cmd_vel:
    platform_allow:
      - apollo510_evb
      - native_sim
      - native_sim/native/64
    integration_platforms:
      - native_sim
  arb.bench.e2e_cmd_vel.loaded:
    extra_configs:
      - CONFIG_ZBUS=y
      - CONFIG_LOG=y
      - CONFIG_BENCH_LOAD=y
    platform_allow:
      - apollo510_evb
      - native_sim
      - native_sim/native/64
    integration_platforms:
      - native_sim
  arb.bench.e2e_cmd_vel.echo:
    extra_configs:
      - CONFIG_SERIAL=y
      - CONFIG_UART_INTERRUPT_DRIVEN=y
      - CONFIG_ARB_BENCH_E2E_ECHO=y
    platform_allow:
      - apollo510_evb
    harness_config:
      fixture: fixture_arb_echo
      type: one_line
      regex:
        - "BENCH DONE"
      record:
        regex:
          - "RECORD:(?P<metrics>.*)"
        as_json: ["metrics"]
```

## ambiq-robotics/benchmarks/irq_latency/testcase.yaml
```yaml
common:
  tags:
    - arb
    - benchmark
  harness: console
  timeout: 300
  harness_config:
    type: one_line
    regex:
      - "BENCH DONE"
    record:
      regex:
        - "RECORD:(?P<metrics>.*)"
      as_json: ["metrics"]
  platform_allow:
    - apollo510_evb
    - native_sim
    - native_sim/native/64
  integration_platforms:
    - native_sim
tests:
  arb.bench.irq_latency: {}
  arb.bench.irq_latency.loaded:
    extra_configs:
      - CONFIG_ZBUS=y
      - CONFIG_LOG=y
      - CONFIG_BENCH_LOAD=y
```

## ambiq-robotics/benchmarks/sched_jitter/testcase.yaml
```yaml
common:
  tags:
    - arb
    - benchmark
  harness: console
  timeout: 300
  harness_config:
    type: one_line
    regex:
      - "BENCH DONE"
    record:
      regex:
        - "RECORD:(?P<metrics>.*)"
      as_json: ["metrics"]
  platform_allow:
    - apollo510_evb
    - native_sim
    - native_sim/native/64
    - qemu_cortex_m3
  integration_platforms:
    - native_sim
tests:
  arb.bench.sched_jitter: {}
  arb.bench.sched_jitter.loaded:
    extra_configs:
      - CONFIG_ZBUS=y
      - CONFIG_LOG=y
      - CONFIG_BENCH_LOAD=y
```

## ambiq-robotics/port/zephyr/Kconfig
```kconfig
# Ambiq Robotics Broker (ARB) - Zephyr integration
#
# SPDX-License-Identifier: Apache-2.0
# Copyright (c) 2026 Ambiq Micro Inc. <www.ambiq.com>

menuconfig ARB
	bool "Ambiq Robotics Broker (ARB) middleware"
	help
	  OS-agnostic robotics pub/sub + service broker with a HAL abstraction
	  for motors, encoders and IMUs, ported onto Zephyr primitives.

if ARB

config ARB_QUEUE_DEPTH
	int "Dispatch queue depth"
	default 16
	help
	  Number of messages buffered between arb_topic_publish() and delivery.

config ARB_MAX_TOPICS
	int "Maximum advertised topics"
	default 16

config ARB_MAX_SUBSCRIBERS
	int "Maximum subscribers (total, across all topics)"
	default 32

config ARB_MAX_SERVICES
	int "Maximum registered services"
	default 16

config ARB_DISPATCH_THREAD
	bool "Run a dedicated dispatcher thread"
	default y
	help
	  When enabled, a kernel thread blocks on the message queue and delivers
	  messages to subscribers automatically. When disabled, the application
	  must call arb_platform_dispatch() itself.

if ARB_DISPATCH_THREAD

config ARB_DISPATCH_THREAD_STACK_SIZE
	int "Dispatcher thread stack size"
	default 2048

config ARB_DISPATCH_THREAD_PRIORITY
	int "Dispatcher thread priority"
	default 5

endif # ARB_DISPATCH_THREAD

config ARB_MICRO_ROS_BRIDGE
	bool "micro-ROS bridge"
	default n
	help
	  Build the micro-ROS adapter that mirrors internal ARB topics to ROS2
	  publishers/subscribers. Requires the micro-ROS Zephyr module.

config ARB_JAUS_BRIDGE
	bool "JAUS bridge (UDP)"
	default n
	select NETWORKING
	select NET_UDP
	select NET_SOCKETS
	help
	  Build the JAUS (SAE AS-4) bridge with a Zephyr UDP transport, exposing
	  the node on a JAUS network (SetWrenchEffort -> /cmd_vel; /odom ->
	  ReportVelocityState/ReportLocalPose).

endif # ARB
```

## ambiq-robotics/samples/nuttx/Kconfig
```kconfig
# ARB NuttX sample
#
# SPDX-License-Identifier: Apache-2.0

config ARB_DIFFDRIVE
	tristate "ARB differential-drive sample"
	default n
	---help---
		Ambiq Robotics Broker closed-loop differential-drive node
		(diff_drive + PID) running on the NuttX broker port.

if ARB_DIFFDRIVE

config ARB_DIFFDRIVE_PROGNAME
	string "Program name"
	default "arb_diffdrive"

config ARB_DIFFDRIVE_PRIORITY
	int "Task priority"
	default 100

config ARB_DIFFDRIVE_STACKSIZE
	int "Stack size"
	default 4096

endif
```

## ambiq-robotics/tests/arb/testcase.yaml
```yaml
tests:
  arb.core:
    tags: arb
    platform_allow:
      - native_sim
      - native_sim/native/64
      - qemu_cortex_m3
    integration_platforms:
      - native_sim
  arb.transport.udp_loopback:
    tags: arb
    platform_allow:
      - native_sim
      - native_sim/native/64
    integration_platforms:
      - native_sim
    extra_configs:
      - CONFIG_ARB_TRANSPORT=y
      - CONFIG_ARB_TRANSPORT_UDP=y
      - CONFIG_NETWORKING=y
      - CONFIG_NET_DRIVERS=y
      - CONFIG_NET_SOCKETS=y
      - CONFIG_NET_SOCKETS_OFFLOAD=y
      - CONFIG_NET_NATIVE_OFFLOADED_SOCKETS=y
      - CONFIG_ETH_NATIVE_TAP=n
```

## weaver_scheduler/kernel/Kconfig.weaver
```kconfig
# Weaver predictive pressure-aware scheduler configuration

# Copyright (c) 2026 Ambiq Micro, Inc.
# SPDX-License-Identifier: Apache-2.0

menuconfig WEAVER_SCHED
	bool "Weaver predictive pressure-aware scheduler layer"
	depends on MULTITHREADING
	help
	  Enables the Weaver scheduling layer: a fixed-point (Q16.16),
	  pressure-aware dispatcher that classifies threads as Warp (hard
	  real-time) or Weft (opportunistic) and boosts the highest-pressure
	  Weft thread each tick. Integer-only math; no FPU dependency.
	  Designed for low-power MCUs (Apollo510 LP @ 96 MHz, nRF52840 @
	  64 MHz) handling wearable sensor pipelines.

if WEAVER_SCHED

config WEAVER_MAX_THREADS
	int "Maximum number of Weaver-managed threads"
	default 12 if WEAVER_WEARABLE_PRESET
	default 8
	range 1 64
	help
	  Bounds the per-tick scheduler evaluation cost. The dispatcher
	  iterates a fixed-size array, so latency is deterministic at
	  approximately 10-15 CPU cycles per registered thread.

config WEAVER_THROTTLE_THRESHOLD
	hex "System pressure throttle threshold (Q16.16 sum)"
	default 0x00030000 if WEAVER_WEARABLE_PRESET
	default 0x00040000
	help
	  Center of the fuzzy throttle controller's MID region (in Q16.16).
	  The TSK rules are:
	    LOW  (level=0):    pressure <= T/2
	    MID  (level=ramp): pressure in (T/2, 3T/2) - centered on T
	    HIGH (level=255):  pressure >= 3T/2
	  pressure == T yields level == 128, the binary throttle boundary.
	  Output is EMA-smoothed across 4 ticks so weaver_should_throttle()
	  does not flap when pressure dances around T. Default 0x40000 ~=
	  4.0 in Q16.16. Wearable preset uses 3.0 because FIFO overruns
	  lose irreplaceable biometric data.

config WEAVER_DEFAULT_BOOST_LEVELS
	int "Default Weft promotion magnitude (priority levels)"
	default 2 if WEAVER_WEARABLE_PRESET
	default 1
	range 1 4
	help
	  How many Zephyr priority levels a winning Weft thread climbs
	  when promoted. Wearables benefit from a stronger boost (2)
	  because sensor-fusion buffer overruns are user-visible bugs.

config WEAVER_PREWARP_GUARD_TICKS
	int "Pre-Warp guard window (ticks)"
	default 1
	range 0 16
	help
	  When the next Warp deadline is within this many ticks, the
	  dispatcher suppresses Weft promotion for the current pass to
	  give the deadline-bound thread a quiet system and warm cache.
	  This implements the "Pattern Slicing" strategy. Set to 0 to
	  disable.

config WEAVER_POWER_AWARE
	bool "Skip dispatch passes when no Weft has pressure"
	default y if WEAVER_WEARABLE_PRESET
	default n
	help
	  When set, weaver_tick() returns early if every Weft thread has
	  zero pressure. This prevents priority churn from blocking
	  deepsleep entry on battery-powered designs.

config WEAVER_USE_MVE
	bool "Use Helium MVE intrinsics for the pressure inner loop"
	depends on CPU_CORTEX_M55 || CPU_HAS_MVE
	default n
	help
	  Vectorize weaver_calculate_pressure_batch() using Helium MVE so
	  four threads' pressures are computed in parallel. Worth enabling
	  only when WEAVER_MAX_THREADS exceeds about 32, because vector
	  register save/restore on every preemption (~50 cycles) eats the
	  per-tick savings at low thread counts. Default off; integer path
	  is faster for typical wearable workloads.

config WEAVER_TIMING
	bool "Measure dispatcher cycles via DWT cycle counter"
	depends on CPU_HAS_DWT
	default n
	help
	  Enables weaver_get_last_tick_cycles() which returns the cycle
	  count of the most recent weaver_tick(). Used for on-target WCET
	  validation. Costs ~6 cycles per tick to read the counter twice.

config WEAVER_WEARABLE_PRESET
	bool "Wearable / Apollo510 LP-mode preset"
	default n
	help
	  Tunes Weaver defaults for a 96 MHz Apollo510 wearable workload:
	    - 12 thread slots (IMU, PPG, temp, BLE LL, GATT TX, fusion,
	      HR algorithm, classifier, display, NVM, logger, idle)
	    - Boost magnitude 2 (FIFO overrun is data loss)
	    - Tighter throttle (3.0 in Q16.16 vs 4.0 default)
	    - Power-aware tick skipping enabled
	  Override individual settings below if needed.

config WEAVER_SCHED_LOG_LEVEL
	int "Weaver scheduler log level"
	depends on LOG
	default 2
	range 0 4
	help
	  Log level for the Weaver scheduling layer.
	    0 = off, 1 = error, 2 = warning, 3 = info, 4 = debug.

endif # WEAVER_SCHED
```

## weaver_scheduler/kernel/Kconfig.weaver_fp
```kconfig
# Weaver scheduler: single-precision floating-point variant.

# Copyright (c) 2026 Ambiq Micro, Inc.
# SPDX-License-Identifier: Apache-2.0

menuconfig WEAVER_SCHED_FP
	bool "Weaver pressure-aware scheduler (floating-point variant)"
	depends on MULTITHREADING && CPU_HAS_FPU
	depends on !WEAVER_SCHED
	help
	  Enables the single-precision floating-point implementation of the
	  Weaver scheduler. Same Warp/Weft semantics, same fuzzy throttle
	  and predictive fill helpers as CONFIG_WEAVER_SCHED, just with
	  IEEE-754 float math instead of Q16.16.

	  Pick this variant when:
	    - Your system already pays the FPU lazy-stacking tax because
	      other threads (sensor fusion, FFT, graphics) use the FPU;
	    - You want a code path that is easier to audit than the
	      Q16.16 one;
	    - Apollo510 is in HP mode (192/250 MHz) where FP cost is
	      negligible vs available cycles.

	  Pick WEAVER_SCHED (fixed-point) when:
	    - Battery-constrained wearable in LP mode (96 MHz) where no
	      other thread uses the FPU;
	    - The MCU has no FPU at all;
	    - Bit-identical reproducibility is required.

	  Mutually exclusive with CONFIG_WEAVER_SCHED.

if WEAVER_SCHED_FP

config WEAVER_FP_MAX_THREADS
	int "Maximum number of FP Weaver-managed threads"
	default 12 if WEAVER_FP_WEARABLE_PRESET
	default 8
	range 1 64

config WEAVER_FP_THROTTLE_THRESHOLD_X1000
	int "Throttle threshold (multiply by 0.001 for the float value)"
	default 3000 if WEAVER_FP_WEARABLE_PRESET
	default 4000
	help
	  Float thresholds aren't expressible directly as Kconfig values,
	  so we store 1000 * threshold and divide in C. Default 4000 maps
	  to a threshold of 4.0 (four Weft threads at full pressure). The
	  wearable preset uses 3000 (=3.0).

config WEAVER_FP_DEFAULT_BOOST_LEVELS
	int "Default Weft promotion magnitude"
	default 2 if WEAVER_FP_WEARABLE_PRESET
	default 1
	range 1 4

config WEAVER_FP_PREWARP_GUARD_TICKS
	int "Pre-Warp guard window (ticks)"
	default 1
	range 0 16

config WEAVER_FP_POWER_AWARE
	bool "Skip dispatch passes when no Weft has pressure"
	default y if WEAVER_FP_WEARABLE_PRESET
	default n

config WEAVER_FP_TIMING
	bool "Measure dispatcher cycles via DWT cycle counter"
	depends on CPU_HAS_DWT
	default n

config WEAVER_FP_WEARABLE_PRESET
	bool "Wearable / Apollo510 preset for FP variant"
	default n
	help
	  Same wearable defaults as WEAVER_WEARABLE_PRESET in the fixed-
	  point variant: 12 thread slots, boost 2, throttle 3.0,
	  power-aware tick skip.

config WEAVER_FP_LOG_LEVEL
	int "FP Weaver scheduler log level"
	depends on LOG
	default 2
	range 0 4

endif # WEAVER_SCHED_FP
```

## weaver_scheduler/tests/kernel/weaver_api/testcase.yaml
```yaml
tests:
  kernel.weaver_api:
    tags: kernel weaver
    integration_platforms:
      - native_sim
      - native_sim/native/64
      - qemu_cortex_m3
    harness: ztest
    harness_config:
      fixture: weaver_api
```

## weaver_scheduler/tests/kernel/weaver_fp_vs_fixed/testcase.yaml
```yaml
tests:
  kernel.weaver_fp_vs_fixed:
    tags: kernel weaver
    integration_platforms:
      - native_sim
    harness: console
    harness_config:
      type: one_line
      regex:
        - "FIXED AND FLOAT VARIANTS EQUIVALENT"
```

## weaver_scheduler/tests/kernel/weaver_paths_equiv/testcase.yaml
```yaml
tests:
  kernel.weaver_paths_equiv:
    tags: kernel weaver
    integration_platforms:
      - native_sim
      - native_sim/native/64
    harness: ztest
    harness_config:
      fixture: weaver_paths_equiv
```

## weaver_scheduler/tests/kernel/weaver_stress/testcase.yaml
```yaml
tests:
  kernel.weaver_stress:
    tags: kernel weaver
    integration_platforms:
      - native_sim
      - native_sim/native/64
    harness: ztest
    harness_config:
      fixture: weaver_stress
    timeout: 60
```
