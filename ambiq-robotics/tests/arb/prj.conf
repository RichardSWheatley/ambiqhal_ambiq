## CMakeLists.txt
```
# SPDX-License-Identifier: Apache-2.0
cmake_minimum_required(VERSION 3.20.0)
find_package(Zephyr REQUIRED HINTS $ENV{ZEPHYR_BASE})
project(arb_tests)

target_sources(app PRIVATE src/main.c src/timesync_test.c)
target_sources_ifdef(CONFIG_ARB_TRANSPORT_UDP app PRIVATE src/transport_udp_test.c)
```

## prj.conf
```kconfig
CONFIG_ZTEST=y
CONFIG_ARB=y
CONFIG_LOG=y
```

## src/main.c
```c
/*
 * ARB - unit tests (native_sim / qemu).
 *
 * SPDX-License-Identifier: Apache-2.0
 * Copyright (c) 2026 Ambiq Micro Inc. <www.ambiq.com>
 */
#include <zephyr/ztest.h>
#include <zephyr/zbus/zbus.h>

#include "arb/topics.h"
#include "arb/node.h"
#include "arb/serial.h"
#include "arb/control/pid.h"
#include "arb/control/diff_drive.h"

/* ---- serial codec ------------------------------------------------------- */

static uint8_t  loop_buf[256];
static size_t   loop_len;
static uint16_t got_topic;
static uint8_t  got_payload[ARB_MSG_MAX_SIZE];
static size_t   got_len;

static int loop_write(void *ctx, const uint8_t *buf, size_t len)
{
	ARG_UNUSED(ctx);
	zassert_true(loop_len + len <= sizeof(loop_buf));
	memcpy(&loop_buf[loop_len], buf, len);
	loop_len += len;
	return 0;
}

static void frame_cb(uint16_t topic, const void *payload, size_t len,
		     void *user)
{
	ARG_UNUSED(user);
	got_topic = topic;
	got_len   = len;
	memcpy(got_payload, payload, len);
}

ZTEST(arb, test_serial_roundtrip)
{
	arb_serial_t tx, rx;
	uint8_t payload[24];

	for (size_t i = 0; i < sizeof(payload); i++) {
		payload[i] = (uint8_t)(i * 7 + 1);
	}

	loop_len = 0;
	got_len = 0;
	zassert_ok(arb_serial_init(&tx, loop_write, NULL, NULL, NULL));
	zassert_ok(arb_serial_init(&rx, NULL, NULL, frame_cb, NULL));

	zassert_ok(arb_serial_send(&tx, ARB_TOPIC_IMU, payload,
				   sizeof(payload)));
	/* leading garbage must resync */
	arb_serial_rx_byte(&rx, 0x00);
	arb_serial_rx_byte(&rx, 0xFF);
	arb_serial_rx(&rx, loop_buf, loop_len);

	zassert_equal(rx.rx_frames, 1);
	zassert_equal(rx.rx_crc_errors, 0);
	zassert_equal(got_topic, ARB_TOPIC_IMU);
	zassert_equal(got_len, sizeof(payload));
	zassert_mem_equal(got_payload, payload, sizeof(payload));
}

ZTEST(arb, test_serial_crc_reject)
{
	arb_serial_t tx, rx;
	uint8_t payload[8] = { 1, 2, 3, 4, 5, 6, 7, 8 };

	loop_len = 0;
	zassert_ok(arb_serial_init(&tx, loop_write, NULL, NULL, NULL));
	zassert_ok(arb_serial_init(&rx, NULL, NULL, frame_cb, NULL));

	zassert_ok(arb_serial_send(&tx, ARB_TOPIC_ODOM, payload,
				   sizeof(payload)));
	loop_buf[6] ^= 0x55; /* corrupt payload */
	arb_serial_rx(&rx, loop_buf, loop_len);

	zassert_equal(rx.rx_frames, 0);
	zassert_equal(rx.rx_crc_errors, 1);
}

ZTEST(arb, test_crc16_vector)
{
	/* CRC-16/CCITT-FALSE("123456789") = 0x29B1 */
	uint16_t crc = arb_serial_crc16(0xFFFF, (const uint8_t *)"123456789",
					9);
	zassert_equal(crc, 0x29B1, "crc=0x%04x", crc);
}

/* ---- control ------------------------------------------------------------ */

ZTEST(arb, test_pid_converges)
{
	arb_pid_t pid;
	float plant = 0.0f;

	arb_pid_init(&pid, 0.8f, 4.0f, 0.0f, -10.0f, 10.0f);
	for (int i = 0; i < 400; i++) {
		float u = arb_pid_update(&pid, 5.0f, plant, 0.01f);

		plant += 0.5f * u * 0.01f + (5.0f - plant) * 0.0f;
		plant += 0.0f;
		plant  = plant + 0.5f * (u - plant) * 0.01f; /* lag plant */
	}
	zassert_within(plant, 5.0f, 0.5f, "plant=%f", (double)plant);
}

ZTEST(arb, test_diffdrive_inverse)
{
	const arb_diffdrive_t dd = { .wheel_base = 0.3f, .wheel_radius = 0.05f };
	float wl, wr, v, w;

	arb_diffdrive_twist_to_wheels(&dd, 0.5f, 1.2f, &wl, &wr);
	arb_diffdrive_wheels_to_twist(&dd, wl, wr, &v, &w);

	zassert_within(v, 0.5f, 1e-4f);
	zassert_within(w, 1.2f, 1e-4f);
}

/* ---- node lifecycle ----------------------------------------------------- */

static int calls_cfg, calls_act, calls_shdn;
static int cfg_hook(void *ctx)  { ARG_UNUSED(ctx); calls_cfg++;  return ARB_OK; }
static int act_hook(void *ctx)  { ARG_UNUSED(ctx); calls_act++;  return ARB_OK; }
static int shdn_hook(void *ctx) { ARG_UNUSED(ctx); calls_shdn++; return ARB_OK; }

static const arb_node_ops_t ops = {
	.on_configure = cfg_hook,
	.on_activate  = act_hook,
	.on_shutdown  = shdn_hook,
};

ZTEST(arb, test_node_lifecycle_and_estop)
{
	arb_node_t *n = arb_node_create("t_node", &ops, NULL);

	zassert_not_null(n);
	zassert_equal(n->state, ARB_NODE_INIT);

	/* invalid: activate before configure */
	zassert_equal(arb_node_activate(n), ARB_ERR_STATE);

	zassert_ok(arb_node_configure(n));
	zassert_equal(n->state, ARB_NODE_READY);
	zassert_ok(arb_node_activate(n));
	zassert_equal(n->state, ARB_NODE_ACTIVE);
	zassert_equal(calls_cfg, 1);
	zassert_equal(calls_act, 1);

	zassert_ok(arb_node_estop_all(n->id, 0x42));
	zassert_equal(n->state, ARB_NODE_ESTOP);
	zassert_equal(calls_shdn, 1);

	/* estop message landed on the channel */
	arb_estop_t es;

	zassert_ok(zbus_chan_read(&arb_chan_estop, &es, K_MSEC(10)));
	zassert_equal(es.source, n->id);
	zassert_equal(es.reason, 0x42);
	zassert_equal(es.header.type, ARB_MSG_ESTOP);
}

/* ---- topics ------------------------------------------------------------- */

ZTEST(arb, test_topic_map)
{
	zassert_equal(arb_topic_chan(ARB_TOPIC_CMD_VEL), &arb_chan_cmd_vel);
	zassert_equal(arb_topic_id(&arb_chan_imu), ARB_TOPIC_IMU);
	zassert_is_null(arb_topic_chan(0x7777));
	zassert_equal(arb_topic_id(NULL), 0);
}

ZTEST(arb, test_zbus_pub_read)
{
	arb_twist_t t = { 0 };

	arb_header_init(&t.header, ARB_MSG_TWIST, 0, 123, 9);
	t.linear.x  = 0.25f;
	t.angular.z = -0.5f;
	zassert_ok(zbus_chan_pub(&arb_chan_cmd_vel, &t, K_MSEC(10)));

	arb_twist_t r;

	zassert_ok(zbus_chan_read(&arb_chan_cmd_vel, &r, K_MSEC(10)));
	zassert_within(r.linear.x, 0.25f, 1e-6f);
	zassert_within(r.angular.z, -0.5f, 1e-6f);
	zassert_equal(r.header.seq, 9);
}

/* ---- wire layout --------------------------------------------------------- */

/*
 * The 16-byte header and the framing are shared with peers built from the
 * multi-OS ARB tree; these are the wire-compatibility invariants.
 */
BUILD_ASSERT(sizeof(arb_header_t) == 16);
BUILD_ASSERT(offsetof(arb_header_t, stamp_us) == 0);
BUILD_ASSERT(offsetof(arb_header_t, seq) == 8);
BUILD_ASSERT(offsetof(arb_header_t, type) == 12);
BUILD_ASSERT(offsetof(arb_header_t, source) == 14);
BUILD_ASSERT(sizeof(arb_heartbeat_t) == 24);
BUILD_ASSERT(offsetof(arb_heartbeat_t, flags) == 19); /* the old pad byte */
BUILD_ASSERT(sizeof(arb_timesync_t) == 48);
BUILD_ASSERT(sizeof(arb_twist_t) <= ARB_MSG_MAX_SIZE);
BUILD_ASSERT(sizeof(arb_odom_t) <= ARB_MSG_MAX_SIZE);
BUILD_ASSERT(sizeof(arb_imu_t) <= ARB_MSG_MAX_SIZE);
BUILD_ASSERT(sizeof(arb_motor_cmd_t) <= ARB_MSG_MAX_SIZE);
BUILD_ASSERT(sizeof(arb_encoder_msg_t) <= ARB_MSG_MAX_SIZE);
BUILD_ASSERT(sizeof(arb_battery_t) <= ARB_MSG_MAX_SIZE);
BUILD_ASSERT(sizeof(arb_range_t) <= ARB_MSG_MAX_SIZE);
BUILD_ASSERT(sizeof(arb_pose2d_t) <= ARB_MSG_MAX_SIZE);
BUILD_ASSERT(sizeof(arb_log_t) <= ARB_MSG_MAX_SIZE);
BUILD_ASSERT(sizeof(arb_estop_t) <= ARB_MSG_MAX_SIZE);

ZTEST(arb, test_wire_layout)
{
	/* runtime mirrors of the key compile-time guards, for visibility */
	zassert_equal(sizeof(arb_header_t), 16);
	zassert_equal(offsetof(arb_header_t, seq), 8);
	zassert_equal(offsetof(arb_header_t, type), 12);
	zassert_equal(offsetof(arb_header_t, source), 14);
	zassert_equal(sizeof(arb_heartbeat_t), 24);
	zassert_true(sizeof(arb_log_t) <= ARB_MSG_MAX_SIZE);
}

ZTEST_SUITE(arb, NULL, NULL, NULL, NULL, NULL);
```

## src/timesync_test.c
```c
/*
 * ARB - timesync filter unit tests (pure math, no transport).
 *
 * SPDX-License-Identifier: Apache-2.0
 * Copyright (c) 2026 Ambiq Micro Inc. <www.ambiq.com>
 */
#include <zephyr/ztest.h>

#include "arb/timesync.h"

#define WINDOW   8
#define SLEW_PPM 1000
#define FRESH_US 5000000

/*
 * Build one exchange with a given true offset (server = client + offset)
 * and symmetric one-way delay: t1 at local time "at".
 */
static void feed(arb_ts_filter_t *f, uint64_t at, int64_t true_offset,
		 uint64_t one_way_us, bool expect_ok)
{
	uint64_t t1 = at;
	uint64_t t2 = (uint64_t)((int64_t)(t1 + one_way_us) + true_offset);
	uint64_t t3 = t2 + 50; /* server turnaround */
	uint64_t t4 = (uint64_t)((int64_t)t3 - true_offset) + one_way_us;

	bool ok = arb_ts_filter_sample(f, t1, t2, t3, t4, t4);

	zassert_equal(ok, expect_ok, "sample at %llu: ok=%d expected=%d",
		      (unsigned long long)at, ok, expect_ok);
}

ZTEST(arb_timesync, test_offset_exact)
{
	arb_ts_filter_t f;

	arb_ts_filter_init(&f, WINDOW, SLEW_PPM, FRESH_US);

	/* symmetric path: offset must be recovered exactly */
	feed(&f, 1000000, 250000, 300, true);
	zassert_equal(f.target_offset_us, 250000);
	/* first sample steps the applied offset (pre-sync step) */
	zassert_equal(arb_ts_filter_applied(&f), 250000);

	/* negative offsets work too */
	arb_ts_filter_init(&f, WINDOW, SLEW_PPM, FRESH_US);
	feed(&f, 1000000, -73000, 450, true);
	zassert_equal(f.target_offset_us, -73000);
}

ZTEST(arb_timesync, test_delay_spike_rejected)
{
	arb_ts_filter_t f;
	uint64_t at = 1000000;

	arb_ts_filter_init(&f, WINDOW, SLEW_PPM, FRESH_US);

	for (int i = 0; i < 4; i++) {
		feed(&f, at, 1000, 300, true);
		at += 1000000;
	}
	/* delay spike (10x median): must be rejected, target unchanged */
	feed(&f, at, 500000, 3000, false);
	zassert_equal(f.target_offset_us, 1000);

	/* negative path delay is garbage: rejected */
	zassert_false(arb_ts_filter_sample(&f, 100, 200, 300, 50, at));
}

ZTEST(arb_timesync, test_median_robustness)
{
	arb_ts_filter_t f;
	uint64_t at = 1000000;

	arb_ts_filter_init(&f, WINDOW, SLEW_PPM, FRESH_US);

	/* majority at 5000, one asymmetric-delay outlier at 9000 (same
	 * total delay, so the spike filter passes it - the median kills it)
	 */
	for (int i = 0; i < 5; i++) {
		feed(&f, at, 5000, 300, true);
		at += 1000000;
	}
	feed(&f, at, 9000, 300, true);
	zassert_equal(f.target_offset_us, 5000);
}

ZTEST(arb_timesync, test_slew_monotonic)
{
	arb_ts_filter_t f;
	uint64_t at = 1000000;

	arb_ts_filter_init(&f, WINDOW, SLEW_PPM, FRESH_US);

	/* sync at +10000, then the target steps down 5000 us */
	for (int i = 0; i < 3; i++) {
		feed(&f, at, 10000, 300, true);
		at += 1000000;
	}
	for (int i = 0; i < 5; i++) {
		feed(&f, at, 5000, 300, true);
		at += 1000000;
	}
	zassert_equal(f.target_offset_us, 5000);

	/* link time = local + offset must never decrease while slewing */
	uint64_t prev_link = 0;
	int64_t off = arb_ts_filter_applied(&f);

	zassert_true(off > 5000, "applied should still be above target");
	for (int i = 0; i < 20000; i++) {
		at += 1000;
		uint64_t link = at + (uint64_t)arb_ts_filter_offset(&f, at);

		zassert_true(link > prev_link,
			     "link time ran backward at i=%d", i);
		prev_link = link;
	}
	/* and it must have converged to the target by now */
	zassert_equal(arb_ts_filter_applied(&f), 5000);
}

ZTEST(arb_timesync, test_drift_estimate)
{
	arb_ts_filter_t f;
	uint64_t at = 1000000;

	arb_ts_filter_init(&f, 3, SLEW_PPM, FRESH_US);

	/* peer clock gains 100 us per second: +100000 ppb */
	int64_t off = 0;

	for (int i = 0; i < 20; i++) {
		feed(&f, at, off, 300, true);
		at += 1000000;
		off += 100;
	}
	int32_t ppb = arb_ts_filter_drift_ppb(&f);

	zassert_true(ppb > 50000 && ppb < 150000,
		     "drift estimate %d ppb, expected ~100000", ppb);
}

ZTEST(arb_timesync, test_synced_freshness)
{
	arb_ts_filter_t f;
	uint64_t at = 1000000;

	arb_ts_filter_init(&f, 3, SLEW_PPM, FRESH_US);
	zassert_false(arb_ts_filter_synced(&f, at));

	for (int i = 0; i < 3; i++) {
		feed(&f, at, 1000, 300, true);
		at += 1000000;
	}
	zassert_true(arb_ts_filter_synced(&f, at));
	/* stale after fresh_us with no samples */
	zassert_false(arb_ts_filter_synced(&f, at + FRESH_US + 1000000));
}

ZTEST_SUITE(arb_timesync, NULL, NULL, NULL, NULL, NULL);
```

## src/transport_udp_test.c
```c
/*
 * ARB - UDP transport backend loopback test (native_sim, NSOS).
 *
 * The backend is configured with peer 127.0.0.1:<own port>, so every
 * exported frame arrives right back on the same socket: one publish must
 * produce exactly one received frame (the loop guard keeps the local
 * republication from being exported again, which would echo forever).
 *
 * SPDX-License-Identifier: Apache-2.0
 * Copyright (c) 2026 Ambiq Micro Inc. <www.ambiq.com>
 */
#include <zephyr/ztest.h>
#include <zephyr/zbus/zbus.h>

#include "arb/topics.h"
#include "arb/time.h"
#include "arb/transport.h"

/* counts pose2d publications: local publish + loopback republication */
static volatile uint32_t pose_pubs;

static void pose_count_cb(const struct zbus_channel *chan)
{
	ARG_UNUSED(chan);
	pose_pubs++;
}
ZBUS_LISTENER_DEFINE(pose_count_listener, pose_count_cb);
ZBUS_CHAN_ADD_OBS(arb_chan_pose2d, pose_count_listener, 4);

ZTEST(arb_transport_udp, test_udp_loopback)
{
	uint32_t crc = 0, frames = 0;

	zassert_ok(arb_transport_export(&arb_chan_pose2d));
	pose_pubs = 0;

	arb_pose2d_t p = { 0 };

	arb_header_init(&p.header, ARB_MSG_POSE2D, 1, arb_time_now_us(), 42);
	p.pose.x = 1.5f;
	p.pose.y = -0.25f;
	p.pose.theta = 0.5f;
	zassert_ok(zbus_chan_pub(&arb_chan_pose2d, &p, K_MSEC(10)));

	/*
	 * Expect exactly 2 publications: ours, plus the republication of
	 * the frame after it loops back through the host stack. (Transport
	 * stats can't be used here - timesync traffic also counts frames.)
	 */
	for (int i = 0; i < 100 && pose_pubs < 2; i++) {
		k_sleep(K_MSEC(20));
	}
	zassert_equal(pose_pubs, 2, "expected 2 pose2d pubs, got %u",
		      pose_pubs);

	/* the republication must not have been re-exported (echo loop) */
	k_sleep(K_MSEC(500));
	zassert_equal(pose_pubs, 2, "echo loop: pub count grew to %u",
		      pose_pubs);

	arb_transport_stats(&frames, &crc);
	zassert_equal(crc, 0, "crc errors on loopback");

	/* the loopback republished our message onto the channel */
	arb_pose2d_t r;

	zassert_ok(zbus_chan_read(&arb_chan_pose2d, &r, K_MSEC(10)));
	zassert_equal(r.header.seq, 42);
	zassert_within(r.pose.x, 1.5f, 1e-6f);

	zassert_ok(arb_transport_unexport(&arb_chan_pose2d));
}

#ifdef CONFIG_ARB_TIME_LINK
/*
 * Self-sync: the client's REQ loops back, this board answers as server,
 * the RESP loops back again and feeds the filter. Both ends are the same
 * clock, so the disciplined offset must converge to ~0 and the LINK time
 * source must report synced.
 */
ZTEST(arb_transport_udp, test_udp_self_timesync)
{
	bool synced = false;

	for (int i = 0; i < 100; i++) {
		if (arb_time_synced()) {
			synced = true;
			break;
		}
		k_sleep(K_MSEC(100));
	}
	zassert_true(synced, "timesync never reached synced state");

	int64_t skew = (int64_t)arb_time_now_us() -
		       (int64_t)k_ticks_to_us_floor64(k_uptime_ticks());

	zassert_true(skew > -1000 && skew < 1000,
		     "self-sync offset %lld us, expected ~0", (long long)skew);
}
#endif /* CONFIG_ARB_TIME_LINK */

ZTEST_SUITE(arb_transport_udp, NULL, NULL, NULL, NULL, NULL);
```
